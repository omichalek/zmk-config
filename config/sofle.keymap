
// I am using localized keymap,
// comes from github.com/joelspadin/zmk-locale-generator v1.3.2

#include "keys_cs.h"

#include <behaviors.dtsi>
#include <dt-bindings/zmk/keys.h>
#include <dt-bindings/zmk/mouse.h>
#include <dt-bindings/zmk/bt.h>
// #include <dt-bindings/zmk/rgb.h>
#include <dt-bindings/zmk/ext_power.h>
#include <dt-bindings/zmk/behaviors.h>
#include <dt-bindings/zmk/pointing.h>

// the ZMK_* commands below utilize 'zmk-helpers' by @urob:
#include "zmk-helpers/helper.h"
#define HOST_OS 1  // set to 1 for Linux, default is 0 (Windows)
#include "zmk-helpers/key-labels/sofle.h"  // positional key names for Sofle



// ///   LAYER ORDER   /// //

#define BASE 0
// the important ones:
#define ALT 1 // alternative layout - "vanilla" plain layer without letter layers
#define NAV 2
#define NUM 3
#define MIR 4
#define SYS 5 // unused, incorporate into mirror?

#define ALL 0 1 2 3 4 5

// "letter layers" for diacritics, symbols, maybe half mirroring
#define LYA 6
#define LYE 7
#define LYI 8
#define LYO 9
#define LYU 10
#define LYY 11

#define LYC 12
#define LYD 13
#define LYL 14
#define LYN 15
#define LYR 16
#define LYS 17
#define LYT 18
#define LYZ 19

#define LYX 20

// activate MIRror layer on thumb, by pressing NAV + NUM
ZMK_CONDITIONAL_LAYER(lyr_mir, NAV NUM, MIR)



// ///   EC11 Encoders   /// //
&sensors {
  triggers-per-rotation = <30>;
};



// ///   CUSTOM   /// //


// already defined in https://github.com/urob/zmk-helpers/blob/main/include/zmk-helpers/key-labels/sofle.h
// NUMROW
// KEYS_L KEYS_R
// THUMBS THUMBS_L THUMBS_R

//&lt {
//	hold-trigger-key-positions = <THUMBS>;
//};

/ {
behaviors {

	//////  LETTER LAYERS  //////  //////  //////
	ll: layer_tap {
		compatible = "zmk,behavior-hold-tap";
		#binding-cells = <2>;
		flavor = "tap-preferred";
		hold-trigger-key-positions = <THUMBS>;
		tapping-term-ms = <200>;
		bindings = <&mo>, <&kp>;
		display-name = "Letter-Layer";
	};

	lt: layer_tap {
		compatible = "zmk,behavior-hold-tap";
		#binding-cells = <2>;
		hold-while-undecided;        //
		flavor = "hold-preferred";   //  changed from the default tap-preferred
		tapping-term-ms = <200>;
		bindings = <&mo>, <&kp>;
		display-name = "Layer-Tap";
	};
	
	
	ht: hold_tap-default {
		compatible = "zmk,behavior-hold-tap";
		#binding-cells = <2>;
		tapping-term-ms = <150>;      // 150
		quick-tap-ms = <0>;
		flavor = "hold-preferred";    // the default
		bindings = <&kp>, <&kp>;      // HOLD TAP
	};

	hht: hold_tap_hold-pref_right {
		compatible = "zmk,behavior-hold-tap";
		hold-while-undecided;
		#binding-cells = <2>;
		tapping-term-ms = <150>;      // 150
		quick-tap-ms = <0>;
		flavor = "hold-preferred";    // hh
		bindings = <&kp>, <&kp>;      // HOLD TAP
	};
	
	htt: hold_tap_tap-pref {
		compatible = "zmk,behavior-hold-tap";
		#binding-cells = <2>;
		tapping-term-ms = <150>;
		quick-tap-ms = <0>;
		flavor = "tap-preferred";   // tt
		bindings = <&kp>, <&kp>;    // HOLD TAP
	};

	//  CUSTOM F-KEYS using TAP DANCE  //  UNUSED    
	my_f1: tap_dance_f1 {
		compatible = "zmk,behavior-tap-dance";
		#binding-cells = <0>;
		tapping-term-ms = <155>;
		bindings = <&hht F1 ESC>, <&kp LC(F1)>;
	};

	encoder_scroll: encoder_scroll {
		compatible = "zmk,behavior-sensor-rotate";
		#sensor-binding-cells = <0>;
		bindings = <&msc SCRL_DOWN>, <&msc SCRL_UP>;
	};
	
  };
};


// ////////////////////   CUSTOM KEYS    //////////////////////////////////////////////////////////
// ?!
ZMK_MOD_MORPH(my_qmem, bindings = <&kp CS_QMARK>, <&kp CS_EXCL>; mods = <(MOD_LSFT|MOD_RSFT)>;)
// ,;   comma / semicolon
ZMK_MOD_MORPH(my_cose, bindings = <&kp CS_COMMA>, <&kp CS_SEMICOLON>; mods = <(MOD_LSFT|MOD_RSFT)>;)
// .,   dot / comma		for a numpad maybe
ZMK_MOD_MORPH(my_doco, bindings = <&kp CS_PERIOD>, <&kp CS_COMMA>; mods = <(MOD_LSFT|MOD_RSFT)>;)
// rm = backspace / delete
ZMK_MOD_MORPH(my_rm,   bindings = <&kp BSPC>, <&kp DEL>; mods = <(MOD_LSFT|MOD_RSFT)>;)
// "'   quotes doubles / single
ZMK_MOD_MORPH(my_quo,  bindings = <&kp CS_DOUBLE_QUOTES>, <&kp CS_SINGLE_QUOTE>; mods = <(MOD_LSFT|MOD_RSFT)>;)
// /\   slashes
ZMK_MOD_MORPH(my_slsh,  bindings = <&kp KP_DIVIDE>, <&kp CS_BACKSLASH>; mods = <(MOD_LSFT|MOD_RSFT)>;)
// *×   multiply
ZMK_MOD_MORPH(my_mult,  bindings = <&kp KP_MULTIPLY>, <&kp CS_MULTIPLY>; mods = <(MOD_LSFT|MOD_RSFT)>;)
// +#   plus / hash
ZMK_MOD_MORPH(my_plshsh,  bindings = <&kp KP_PLUS>, <&kp RA(X)>; mods = <(MOD_LSFT|MOD_RSFT)>;)
// -=   minus / equals
ZMK_MOD_MORPH(my_mineql,  bindings = <&kp KP_MINUS>, <&kp CS_EQUAL>; mods = <(MOD_LSFT|MOD_RSFT)>;)



// /  CUSTOM diacritics, shifted variants work as follows:
//     1. macro for lower case   2. macro for upper case   3. mod morph to combine them

//   á
ZMK_MACRO(my_aau,    bindings = <&kp CS_ACUTE &kp LS(A)>;)
ZMK_MOD_MORPH(my_aa, bindings = <&kp CS_A_ACUTE>, <&my_aau>; mods = <(MOD_LSFT|MOD_RSFT)>;)
//
ZMK_MACRO(my_aull,    bindings = <&kp CS_UMLAUT &kp A>;)
ZMK_MACRO(my_aulu,    bindings = <&kp CS_UMLAUT &kp LS(A)>;)
ZMK_MOD_MORPH(my_aul, bindings = <&my_aull>, <&my_aulu>; mods = <(MOD_LSFT|MOD_RSFT)>;)

//   é
ZMK_MACRO(my_eeu,    bindings = <&kp CS_ACUTE &kp LS(E)>;)
ZMK_MOD_MORPH(my_ee, bindings = <&kp CS_E_ACUTE>, <&my_eeu>; mods = <(MOD_LSFT|MOD_RSFT)>;)
//
ZMK_MACRO(my_ijeu,    bindings = <&kp CS_CARON &kp LS(E)>;)
ZMK_MOD_MORPH(my_ije, bindings = <&kp CS_E_CARON>, <&my_ijeu>; mods = <(MOD_LSFT|MOD_RSFT)>;)

//   í
ZMK_MACRO(my_iiu,    bindings = <&kp CS_ACUTE &kp LS(I)>;)
ZMK_MOD_MORPH(my_ii, bindings = <&kp CS_I_ACUTE>, <&my_iiu>; mods = <(MOD_LSFT|MOD_RSFT)>;)

//   ó
ZMK_MACRO(my_ool,    bindings = <&kp CS_ACUTE &kp O>;)
ZMK_MACRO(my_oou,    bindings = <&kp CS_ACUTE &kp LS(O)>;)
ZMK_MOD_MORPH(my_oo, bindings = <&my_ool>, <&my_oou>; mods = <(MOD_LSFT|MOD_RSFT)>;)
//   Ô ô   CS_CARET
ZMK_MACRO(my_ocl,    bindings = <&kp CS_CARET &kp O>;)
ZMK_MACRO(my_ocu,    bindings = <&kp CS_CARET &kp LS(O)>;)
ZMK_MOD_MORPH(my_oc, bindings = <&my_ocl>, <&my_ocu>; mods = <(MOD_LSFT|MOD_RSFT)>;)
//   
ZMK_MACRO(my_oull,    bindings = <&kp CS_UMLAUT &kp O>;)
ZMK_MACRO(my_oulu,    bindings = <&kp CS_UMLAUT &kp LS(O)>;)
ZMK_MOD_MORPH(my_oul, bindings = <&my_oull>, <&my_oulu>; mods = <(MOD_LSFT|MOD_RSFT)>;)

//   ú
ZMK_MACRO(my_uuu,    bindings = <&kp CS_ACUTE &kp LS(U)>;)
ZMK_MOD_MORPH(my_uu, bindings = <&kp CS_U_ACUTE>, <&my_uuu>; mods = <(MOD_LSFT|MOD_RSFT)>;)
//
ZMK_MACRO(my_uou,    bindings = <&kp CAPS &kp CS_U_RING &kp CAPS>;)
ZMK_MOD_MORPH(my_uo, bindings = <&kp CS_U_RING>, <&my_uou>; mods = <(MOD_LSFT|MOD_RSFT)>;)
//
ZMK_MACRO(my_uull,    bindings = <&kp CS_UMLAUT &kp U>;)
ZMK_MACRO(my_uulu,    bindings = <&kp CS_UMLAUT &kp LS(U)>;)
ZMK_MOD_MORPH(my_uul, bindings = <&my_uull>, <&my_uulu>; mods = <(MOD_LSFT|MOD_RSFT)>;)

//   ý
ZMK_MACRO(my_yyu,    bindings = <&kp CS_ACUTE &kp LS(CS_Y)>;)
ZMK_MOD_MORPH(my_yy, bindings = <&kp CS_Y_ACUTE>, <&my_yyu>; mods = <(MOD_LSFT|MOD_RSFT)>;)



//   č
ZMK_MACRO(my_chu,    bindings = <&kp CS_CARON &kp LS(C)>;)
ZMK_MOD_MORPH(my_ch, bindings = <&kp CS_C_CARON>, <&my_chu>; mods = <(MOD_LSFT|MOD_RSFT)>;)
//   Ç ç   CS_CEDILLA
ZMK_MACRO(my_ccl,    bindings = <&kp CS_CEDILLA &kp C>;)
ZMK_MACRO(my_ccu,    bindings = <&kp CS_CEDILLA &kp LS(C)>;)
ZMK_MOD_MORPH(my_cc, bindings = <&my_ccl>, <&my_ccu>; mods = <(MOD_LSFT|MOD_RSFT)>;)

//   ď
ZMK_MACRO(my_dhl,    bindings = <&kp CS_CARON &kp D>;)
ZMK_MACRO(my_dhu,    bindings = <&kp CS_CARON &kp LS(D)>;)
ZMK_MOD_MORPH(my_dh, bindings = <&my_dhl>, <&my_dhu>; mods = <(MOD_LSFT|MOD_RSFT)>;)

//   ľ
ZMK_MACRO(my_lhl,    bindings = <&kp CS_CARON &kp L>;)
ZMK_MACRO(my_lhu,    bindings = <&kp CS_CARON &kp LS(L)>;)
ZMK_MOD_MORPH(my_lh, bindings = <&my_lhl>, <&my_lhu>; mods = <(MOD_LSFT|MOD_RSFT)>;)

//   Ĺ ĺ
ZMK_MACRO(my_lll,    bindings = <&kp CS_ACUTE &kp L>;)
ZMK_MACRO(my_llu,    bindings = <&kp CS_ACUTE &kp LS(L)>;)
ZMK_MOD_MORPH(my_ll, bindings = <&my_lll>, <&my_llu>; mods = <(MOD_LSFT|MOD_RSFT)>;)

//   ň
ZMK_MACRO(my_nhl,    bindings = <&kp CS_CARON &kp N>;)
ZMK_MACRO(my_nhu,    bindings = <&kp CS_CARON &kp LS(N)>;)
ZMK_MOD_MORPH(my_nh, bindings = <&my_nhl>, <&my_nhu>; mods = <(MOD_LSFT|MOD_RSFT)>;)
//   
ZMK_MACRO(my_ntl,    bindings = <&kp CS_TILDE &kp N>;)
ZMK_MACRO(my_ntu,    bindings = <&kp CS_TILDE &kp LS(N)>;)
ZMK_MOD_MORPH(my_nt, bindings = <&my_ntl>, <&my_ntu>; mods = <(MOD_LSFT|MOD_RSFT)>;)

//   ř
ZMK_MACRO(my_rhu,    bindings = <&kp CS_CARON &kp LS(R)>;)
ZMK_MOD_MORPH(my_rh, bindings = <&kp CS_R_CARON>, <&my_rhu>; mods = <(MOD_LSFT|MOD_RSFT)>;)
//   Ŕ ŕ
ZMK_MACRO(my_rrl,    bindings = <&kp CS_ACUTE &kp R>;)
ZMK_MACRO(my_rru,    bindings = <&kp CS_ACUTE &kp LS(R)>;)
ZMK_MOD_MORPH(my_rr, bindings = <&my_rrl>, <&my_rru>; mods = <(MOD_LSFT|MOD_RSFT)>;)

//   š
ZMK_MACRO(my_shu,    bindings = <&kp CS_CARON &kp LS(S)>;)
ZMK_MOD_MORPH(my_sh, bindings = <&kp CS_S_CARON>, <&my_shu>; mods = <(MOD_LSFT|MOD_RSFT)>;)
//   CS_ESZETT   CS_SZ

//   ť
ZMK_MACRO(my_thl,    bindings = <&kp CS_CARON &kp T>;)
ZMK_MACRO(my_thu,    bindings = <&kp CS_CARON &kp LS(T)>;)
ZMK_MOD_MORPH(my_th, bindings = <&my_thl>, <&my_thu>; mods = <(MOD_LSFT|MOD_RSFT)>;)

//   ž
ZMK_MACRO(my_zhu,    bindings = <&kp CS_CARON &kp LS(CS_Z)>;)
ZMK_MOD_MORPH(my_zh, bindings = <&kp CS_Z_CARON>, <&my_zhu>; mods = <(MOD_LSFT|MOD_RSFT)>;)


// /   CUSTOM: UNICODE     normal            shifted
// quotation marks
ZMK_UNICODE_PAIR(uc_lo99,   N2, N0, N1, E,    N2, N0, N1, A)      // „ / ‚
ZMK_UNICODE_PAIR(uc_hi66,   N2, N0, N1, C,    N2, N0, N1, N8)     // “ / ‘
ZMK_UNICODE_PAIR(uc_hi99,   N2, N0, N1, D,    N2, N0, N1, N9)     // ” / ’



// ////////////////////   MAIN LAYERS   ///////////////////////////////////////////////////////////


#define xxx &none
#define ___ &trans
#define SPC SPACE
#define LSH LSHFT
#define RSH RSHFT
#define LCT LCTRL
#define RCT RCTRL
// #define ALFA (LH1)


ZMK_LAYER(base,
// &htt F1 ESC
&kp ESC       &kp F2        &kp F3     &kp F4     &kp F5     &kp F6                                &kp PSCRN  &kp HOME   &kp C_PP   &kp END       &kp F11       &kp C_AL_CALC
&kp TAB       &kp Q         &kp W      &kp F      &kp P      &kp G                                 &kp J      &ll LYL L  &ll LYU U  &ll LYY CS_Y  &kp CS_MINUS  &my_rm
&kp LSH       &ll LYA A     &ll LYR R  &ll LYS S  &ll LYT T  &ll LYD D                             &kp H      &ll LYN N  &ll LYE E  &ll LYI I     &ll LYO O     &kp RCT
&ht LALT SPC  &ll LYZ CS_Z  &ll LYX X  &ll LYC C  &kp V      &kp B    &kp C_MUTE      &kp C_MUTE   &my_qmem   &kp M      &kp K      &my_cose      &kp CS_DOT   &hht RALT RET
                            &kp LGUI   &kp SPC    &mo NUM    &mo NAV  &hht LCT RET    &hht RSH SPC &mo NUM    &mo NAV    &kp SPC    &kp LGUI,
&encoder_scroll		&inc_dec_kp C_VOL_UP C_VOL_DN
)


ZMK_LAYER(vanilla,
//  alternative, plain layout in this case 
//&kp GRAVE  &kp N1    &kp N2  &kp N3  &kp N4  &kp N5                           &kp N6  &kp N7  &kp N8  &kp N9     &kp N0      &kp MINUS
&kp ESC  &kp F2    &kp F3  &kp F4  &kp F5  &kp F6                           &kp F7   &kp F8  &kp F9  &kp F10    &kp F11     &kp F12
___      &kp Q     &kp W   &kp F   &kp P   &kp G                            &kp J    &kp L   &kp U   &kp CS_Y   &kp SEMI    &kp EQUAL
___      &kp A     &kp R   &kp S   &kp T   &kp D                            &kp H    &kp N   &kp E   &kp I      &kp O       &kp APOS
___      &kp CS_Z  &kp X   &kp C   &kp V   &kp B    &kp C_MUTE    &tog ALT  &my_qmem &kp M   &kp K   &kp COMMA  &kp PERIOD  &kp SLASH
                   ___     ___     &mo NUM &mo NAV  &kp LCTRL     ___       ___      ___     ___     ___   ,
                        &inc_dec_kp C_VOL_UP C_VOL_DN                            &inc_dec_kp C_BRIGHTNESS_INC C_BRIGHTNESS_DEC
)


ZMK_LAYER(nav-num,
//
&kp F7    &kp F8    &kp F9    &kp F10   &kp F11   &kp F12                       &kp F7          &kp F8     &kp F9     &kp F10    &kp F11       &kp F12
___       &kp ESC   &kp BSPC  &kp UP    &kp DEL   &kp PG_UP                     &kp KP_DIVIDE   &kp KP_N7  &kp KP_N8  &kp KP_N9  &kp KP_MINUS  ___   
___       &kp HOME  &kp LEFT  &kp DOWN  &kp RIGHT &kp END                       &kp KP_MULTIPLY &kp KP_N4  &kp KP_N5  &kp KP_N6  &kp KP_PLUS  ___   
___       &kp RA(A) &kp TAB   &kp SPC   &kp RET   &kp PG_DN    ___      ___     &kp KP_N0       &kp KP_N1  &kp KP_N2  &kp KP_N3  &kp CS_EQUAL  ___   
                    ___       ___       ___       ___          ___      ___     ___             &kp KP_N0  ___        ___   , 
&inc_dec_kp C_VOL_UP C_VOL_DN &inc_dec_kp PG_UP PG_DN
)


ZMK_LAYER(num-nav,
//
&kp GRAVE  &kp N1       &kp N2     &kp N3     &kp N4     &kp N5                             &kp N6     &kp N7    &kp N8    &kp N9    &kp N0     &kp CS_ACUTE
___        &my_slsh     &kp KP_N7  &kp KP_N8  &kp KP_N9  &my_mineql                         &kp PG_UP  &kp BSPC  &kp UP    &kp DEL   &kp ESC    ___   
___        &my_mult     &kp KP_N4  &kp KP_N5  &kp KP_N6  &my_plshsh                         &kp HOME   &kp LEFT  &kp DOWN  &kp RIGHT &kp END    ___   
___        &kp KP_N0    &kp KP_N1  &kp KP_N2  &kp KP_N3  &my_doco     ___           ___     &kp PG_DN  &kp ENTER &kp SPC   &kp TAB   &kp NUBS   ___   
                           ___        ___        ___        ___          ___           ___     ___       ___       ___       ___   ,
&inc_dec_kp C_BRIGHTNESS_INC C_BRIGHTNESS_DEC &inc_dec_kp PG_UP PG_DN
)


ZMK_LAYER(mirror,
//
&kp F1    ___           ___           ___         ___         ___                      &bt BT_SEL 0 &bt BT_SEL 1 &bt BT_SEL 2 &bt BT_SEL 3 &bt BT_SEL 4 &bt BT_CLR
&kp CAPS  &kp CS_MINUS  &ll LYY CS_Y  &ll LYU U   &kp L       &kp J                    &kp G    &kp P    &kp F    &kp W   &kp Q    &kp INS   
___       &ll LYO O     &ll LYI I     &ll LYE E   &ll LYN N   &kp H                    &kp D    &kp T    &kp S    &kp R   &kp A    ___   
___       &kp CS_DOT    &my_cose      &kp K       &kp M       &my_qmem &tog ALT ___    &kp B   &kp V    &kp C    &kp X   &kp CS_Z  ___   
                  ___      ___      ___       ___         ___      ___     ___       ___     ___      ___   ,
&inc_dec_kp DOWN UP &inc_dec_kp C_VOL_UP C_VOL_DN
)


ZMK_LAYER(sys,
//
&bt BT_SEL 0 &bt BT_SEL 1 &bt BT_SEL 2 &bt BT_SEL 3 &bt BT_SEL 4 &bt BT_CLR                      ___       ___       ___      ___       ___     ___   
&kp CAPS     &kp INS      &kp PSCRN    &kp K_CMENU  ___          ___                             &kp PG_UP ___       &kp UP   ___       &kp N0  ___   
___          ___          ___          ___          ___          ___                             &kp PG_DN &kp LEFT  &kp DOWN &kp RIGHT &kp DEL &kp BSPC
___          &kp K_UNDO   &kp K_CUT    &kp K_COPY   &kp K_PASTE  ___      &tog ALT       ___     ___       ___       ___      ___       ___     ___   
                          ___          ___          ___          ___        ___          ___     ___       ___       ___      ___   ,
&inc_dec_kp ___    ___    &inc_dec_kp ___    ___   
)



// ////////////////////   "LETTER LAYERS" for DIACRITICS, SYMBOLS etc.   //////////////////////////
// ////////////////////   vowels / samohlásky   ///////////////////////////////////////////////////

ZMK_LAYER(a,
___    ___    ___    ___    ___    ___                       ___    ___    ___    ___    ___    ___   
___    ___    ___    ___    ___    ___                       ___    ___    ___    ___    ___    ___   
___    ___    ___    ___    ___    ___                       ___    ___    ___    ___    ___    ___   
___    ___    ___    ___    ___    ___    ___         ___    ___    ___    ___    ___    ___    ___   
        ___    &kp H  &my_aul  &my_aa  &kp CS_AT      &kp CS_AT  &my_aa  &my_aul ___    ___   ,
&inc_dec_kp ___    ___       &inc_dec_kp ___    ___   
)

ZMK_LAYER(e,
___    ___    ___    ___    ___    ___                       ___    ___    ___    ___    ___    ___   
___    ___    ___    ___    ___    ___                       ___    ___    ___    ___    ___    ___   
___    ___    ___    ___    ___    ___                       ___    ___    ___    ___    ___    ___   
___    ___    ___    ___    ___    ___    ___         ___    ___    ___    ___    ___    ___    ___   
&kp CS_EURO  ___     &kp CS_AMPS  &my_ee  &my_ije    &my_ije  &my_ee  &kp CS_AMPS  &kp S  &kp CS_EURO,      
&inc_dec_kp ___    ___       &inc_dec_kp ___    ___    
)

ZMK_LAYER(i,
___    ___    ___    ___    ___    ___                       ___    ___    ___    ___    ___    ___   
___    ___    ___    ___    ___    ___                       ___    ___    ___    ___    ___    ___   
___    ___    ___    ___    ___    ___                       ___    ___    ___    ___    ___    ___   
___    ___    ___    ___    ___    ___    ___         ___    ___    ___    ___    ___    ___    ___   
           ___     ___     ___     &my_ii ___         ___     &my_ii  ___     ___     ___   ,
&inc_dec_kp ___    ___       &inc_dec_kp ___    ___   
)

ZMK_LAYER(o,
___    ___    ___    ___    ___    ___                       ___    ___    ___    ___    ___    ___   
___    ___    ___    ___    ___    ___                       ___    ___    ___    ___    ___    ___   
___    ___    ___    ___    ___    ___                       ___    ___    ___    ___    ___    ___   
___    ___    ___    ___    ___    ___    ___         ___    ___    ___    ___    ___    ___    ___   
         ___     ___     &my_oul  &my_oo  &my_oc      &my_oc  &my_oo  &my_oul ___     ___   ,
&inc_dec_kp ___    ___       &inc_dec_kp ___    ___   
)

ZMK_LAYER(u,
___    ___    ___    ___    ___    ___                       ___    ___    ___    ___    ___    ___   
___    ___    ___    ___    ___    ___                       ___    ___    ___    ___    ___    ___   
___    ___    ___    ___    ___    ___                       ___    ___    ___    ___    ___    ___   
___    ___    ___    ___    ___    ___    ___         ___    ___    ___    ___    ___    ___    ___   
         ___     ___     &my_uul  &my_uu  &my_uo      &my_uo  &my_uu  &my_uul  ___     ___   ,
&inc_dec_kp ___    ___       &inc_dec_kp ___    ___   
)

ZMK_LAYER(y,
___    ___    ___    ___    ___    ___                       ___    ___    ___    ___    ___    ___   
___    ___    ___    ___    ___    ___                       ___    ___    ___    ___    ___    ___   
___    ___    ___    ___    ___    ___                       ___    ___    ___    ___    ___    ___   
___    ___    ___    ___    ___    ___    ___         ___    ___    ___    ___    ___    ___    ___   
          ___     ___     ___     &my_yy  ___         ___     &my_yy  ___     ___     ___   ,
&inc_dec_kp ___    ___       &inc_dec_kp ___    ___   
)

// ////////////////////   consonants / souhlásky   ////////////////////////////////////////////////

ZMK_LAYER(c,
___    ___    ___    ___    ___    ___                       ___    ___    ___    ___    ___    ___   
___    ___    ___    ___    ___    ___                       ___    ___    ___    ___    ___    ___   
___    ___    ___    ___    ___    ___                       ___    ___    ___    ___    ___    ___   
___    ___    ___    ___    ___    ___    ___         ___    ___    ___    ___    ___    ___    ___   
       ___     &kp K  &my_cc  &kp CS_AMPS  &my_ch    &my_ch  &kp CS_AMPS  &my_cc  ___     ___   ,
&inc_dec_kp ___    ___       &inc_dec_kp ___    ___   
)

ZMK_LAYER(d,
___    ___    ___    ___    ___    ___                       ___    ___    ___    ___    ___    ___   
___    ___    ___    ___    ___    ___                       ___    ___    ___    ___    ___    ___   
___    ___    ___    ___    ___    ___                       ___    ___    ___    ___    ___    ___   
___    ___    ___    ___    ___    ___    ___         ___    ___    ___    ___    ___    ___    ___   
           ___     &kp O  ___     ___     &my_dh      &my_dh  ___     ___     ___     ___   ,
&inc_dec_kp ___    ___       &inc_dec_kp ___    ___   
)

ZMK_LAYER(l,
___    ___    ___    ___    ___    ___                       ___    ___    ___    ___    ___    ___   
___    ___    ___    ___    ___    ___                       ___    ___    ___    ___    ___    ___   
___    ___    ___    ___    ___    ___                       ___    ___    ___    ___    ___    ___   
___    ___    ___    ___    ___    ___    ___         ___    ___    ___    ___    ___    ___    ___   
          ___     ___     ___     &my_ll  &my_lh      &my_lh  &my_ll  ___     &kp W  ___   ,
&inc_dec_kp ___    ___       &inc_dec_kp ___    ___   
)

ZMK_LAYER(n,
___    ___    ___    ___    ___    ___                       ___    ___    ___    ___    ___    ___   
___    ___    ___    ___    ___    ___                       ___    ___    ___    ___    ___    ___   
___    ___    ___    ___    ___    ___                       ___    ___    ___    ___    ___    ___   
___    ___    ___    ___    ___    ___    ___         ___    ___    ___    ___    ___    ___    ___   
          ___     ___     &my_nt  ___     &my_nh      &my_nh  ___     &my_nt  &kp R  ___   ,
&inc_dec_kp ___    ___       &inc_dec_kp ___    ___   
)

ZMK_LAYER(r,
___    ___    ___    ___    ___    ___                       ___    ___    ___    ___    ___    ___   
___    ___    ___    ___    ___    ___                       ___    ___    ___    ___    ___    ___   
___    ___    ___    ___    ___    ___                       ___    ___    ___    ___    ___    ___   
___    ___    ___    ___    ___    ___    ___         ___    ___    ___    ___    ___    ___    ___   
           ___     &kp N  ___     &my_rr  &my_rh      &my_rh  &my_rr  ___     ___     ___   ,
&inc_dec_kp ___    ___       &inc_dec_kp ___    ___   
)

ZMK_LAYER(s,
___    ___    ___    ___    ___    ___                       ___    ___    ___    ___    ___    ___   
___    ___    ___    ___    ___    ___                       ___    ___    ___    ___    ___    ___   
___    ___    ___    ___    ___    ___                       ___    ___    ___    ___    ___    ___   
___    ___    ___    ___    ___    ___    ___         ___    ___    ___    ___    ___    ___    ___   
   ___     &kp E  &kp CS_SZ  &kp CS_DLLR  &my_sh      &my_sh  &kp CS_DLLR  &kp CS_SZ  ___     ___   ,
&inc_dec_kp ___    ___       &inc_dec_kp ___    ___   
)

ZMK_LAYER(t,
___    ___    ___    ___    ___    ___                       ___    ___    ___    ___    ___    ___   
___    ___    ___    ___    ___    ___                       ___    ___    ___    ___    ___    ___   
___    ___    ___    ___    ___    ___                       ___    ___    ___    ___    ___    ___   
___    ___    ___    ___    ___    ___    ___         ___    ___    ___    ___    ___    ___    ___   
      ___     &kp I  ___     &kp CS_AMPS  &my_th      &my_th  &kp CS_AMPS  ___     ___     ___   ,
&inc_dec_kp ___    ___       &inc_dec_kp ___    ___   
)

ZMK_LAYER(z,
___    ___    ___    ___    ___    ___                       ___    ___    ___    ___    ___    ___   
___    ___    ___    ___    ___    ___                       ___    ___    ___    ___    ___    ___   
___    ___    ___    ___    ___    ___                       ___    ___    ___    ___    ___    ___   
___    ___    ___    ___    ___    ___    ___         ___    ___    ___    ___    ___    ___    ___   
          ___     ___     ___     ___     &my_zh      &my_zh  ___     ___     ___     ___   ,
&inc_dec_kp ___    ___       &inc_dec_kp ___    ___   
)

// ////////////////////   the fringe ones   ///////////////////////////////////////////////////////

ZMK_LAYER(x,
___    ___    ___    ___    ___    ___                       ___    ___    ___    ___    ___    ___   
___    ___    ___    ___    ___    ___                       ___    ___    ___    ___    ___    ___   
___    ___    ___    ___    ___    ___                       ___    ___    ___    ___    ___    ___   
___    ___    ___    ___    ___    ___    ___         ___    ___    ___    ___    ___    ___    ___   
            ___  ___  &mkp MB1  &mkp MB3  &mkp MB2      ___ &kp RA(X) ___    ___    ___   ,
&inc_dec_kp ___    ___       &inc_dec_kp ___    ___   
)



// ///   CUSTOM COMBOS   /// //


//  MOUSE KEY PRESS
//  left right middle
ZMK_COMBO(mouse-l, &mkp MB1, RN1 RN2, ALL, 50)
ZMK_COMBO(mouse-r, &mkp MB2, RN2 RN3, ALL, 50)
ZMK_COMBO(mouse-m, &mkp MB3, RN1 RN3, ALL, 50)

//  back forward
ZMK_COMBO(mouse-back, &mkp MB4, LN3 LN2, ALL, 50)
ZMK_COMBO(mouse-fwd,  &mkp MB5, LN2 LN1, ALL, 50)
//  context menu (right click?)
ZMK_COMBO(menu, &kp K_CONTEXT_MENU, LM3 LM1, ALL, 50)


// quotation marks
//  „ ‚
// ZMK_COMBO(quotation-low-99, &uc_lo99, LB1 LM1, ALL, 50)
//  ` grave
ZMK_COMBO(grave, &kp CS_GRAVE, LB1 LM1, ALL, 50)
//  " '
ZMK_COMBO(quotation-std0, &my_quo, LB0 LM0, ALL, 50)
ZMK_COMBO(quotation-stdR, &my_quo, RB5 RM5, ALL, 50)

//  ()
ZMK_COMBO(bracket-reg-l, &kp CS_LEFT_PARENTHESIS, RB0 RM0, ALL, 50)
ZMK_COMBO(bracket-reg-r, &kp CS_RIGHT_PARENTHESIS, RB1 RM1, ALL, 50)
//  []
ZMK_COMBO(bracket-sq-l, &kp CS_LEFT_BRACKET, RB0 RT0, ALL, 50)
ZMK_COMBO(bracket-sq-r, &kp CS_RIGHT_BRACKET, RB1 RT1, ALL, 50)
//  curly?
ZMK_COMBO(bracket-curly-l, &kp CS_LBRC, RM0 RT0, ALL, 50)
ZMK_COMBO(bracket-curly-r, &kp CS_RBRC, RM1 RT1, ALL, 50)


